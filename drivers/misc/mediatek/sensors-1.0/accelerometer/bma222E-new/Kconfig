## drivers/misc/mediatek/sensors-1.0/accelerometer/bma222E-new/Kconfig
```kconfig
config MTK_BMA222E_NEW
	bool "MTK_BMA222E_NEW for MediaTek package"
	default n
	help
	  It support different accelerometer sensor.
          If this option is set,
	  it will support
          MTK_BMA222E_NEW Accelerometer.
```
